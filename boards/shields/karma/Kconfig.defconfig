## boards/shields/karma/Kconfig.defconfig
```kconfig
# Copyright (c) 2023 Achyudh Ram
# SPDX-License-Identifier: MIT

if SHIELD_KARMA_LEFT || SHIELD_KARMA_RIGHT || SHIELD_KARMA_DONGLE

config ZMK_KEYBOARD_NAME
    default "Karma"

endif

if SHIELD_KARMA_DONGLE

config ZMK_SPLIT_ROLE_CENTRAL
    default y

config ZMK_SPLIT_BLE_CENTRAL_PERIPHERALS
    default 2

config BT_MAX_CONN
    default 7

config BT_MAX_PAIRED
    default 7

endif

if SHIELD_KARMA_LEFT || SHIELD_KARMA_RIGHT || SHIELD_KARMA_DONGLE

config ZMK_SPLIT
    default y

endif
```

## config/west.yml
```yaml
manifest:
  remotes:
    - name: zmkfirmware
      url-base: https://github.com/zmkfirmware
    - name: arno
      url-base: https://github.com/ArnoVanneste
  projects:
    - name: zmk
      remote: zmkfirmware
      revision: main
      import: app/west.yml
    - name: prospector-zmk-module
      remote: arno
      revision: core/zephyr-4-1
  self:
    path: config
```
